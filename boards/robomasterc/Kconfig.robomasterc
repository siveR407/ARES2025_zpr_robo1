## boards/robomasterc/Kconfig.robomasterc
```kconfig
# Copyright (c) 2020, Erwin Rol <erwin@erwinrol.com>
# SPDX-License-Identifier: Apache-2.0

config BOARD_ROBOMASTERC
	select SOC_STM32F407XE
```

## build/Kconfig/Kconfig.modules
```kconfig
menu "cmsis (/home/sive/my_work/zephyrproject/modules/hal/cmsis)"
osource "$(ZEPHYR_CMSIS_KCONFIG)"
config ZEPHYR_CMSIS_MODULE
	bool
	default y
endmenu
menu "hal_nordic (/home/sive/my_work/zephyrproject/modules/hal/nordic)"
osource "$(ZEPHYR_HAL_NORDIC_KCONFIG)"
config ZEPHYR_HAL_NORDIC_MODULE
	bool
	default y

config ZEPHYR_HAL_NORDIC_MODULE_BLOBS
	bool
endmenu
config ZEPHYR_HAL_STM32_MODULE
	bool
	default y

config ZEPHYR_HAL_STM32_MODULE_BLOBS
	bool
```

## build/Kconfig/Kconfig.sysbuild.modules
```kconfig
config ZEPHYR_CMSIS_MODULE
   bool
   default y
config ZEPHYR_HAL_NORDIC_MODULE
   bool
   default y
config ZEPHYR_HAL_STM32_MODULE
   bool
   default y
```

## build/Kconfig/arch/Kconfig
```kconfig
# Load arch Kconfig descriptions.
osource "/home/sive/my_work/zephyrproject/zephyr/arch/x86/Kconfig"
osource "/home/sive/my_work/zephyrproject/zephyr/arch/xtensa/Kconfig"
osource "/home/sive/my_work/zephyrproject/zephyr/arch/sparc/Kconfig"
osource "/home/sive/my_work/zephyrproject/zephyr/arch/riscv/Kconfig"
osource "/home/sive/my_work/zephyrproject/zephyr/arch/posix/Kconfig"
osource "/home/sive/my_work/zephyrproject/zephyr/arch/nios2/Kconfig"
osource "/home/sive/my_work/zephyrproject/zephyr/arch/mips/Kconfig"
osource "/home/sive/my_work/zephyrproject/zephyr/arch/arm64/Kconfig"
osource "/home/sive/my_work/zephyrproject/zephyr/arch/arm/Kconfig"
osource "/home/sive/my_work/zephyrproject/zephyr/arch/arc/Kconfig"
```
